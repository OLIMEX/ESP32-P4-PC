## SOFTWARE/ESP-IDF/p4_board_demo/components/lan_test/Kconfig
```kconfig
menu "LAN Test"

config LAN_TEST_PHY_ADDR
    int "PHY address"
    default 1

config LAN_TEST_PHY_RST_GPIO
    int "PHY reset GPIO (-1 = none)"
    default -1

config LAN_TEST_MDC_GPIO
    int "SMI MDC GPIO"
    default 41

config LAN_TEST_MDIO_GPIO
    int "SMI MDIO GPIO"
    default 40

config LAN_TEST_RMII_CLK_IN_GPIO
    int "RMII REF_CLK input GPIO (EMAC_RMII_CLK)"
    default 50

config LAN_TEST_DHCP_TIMEOUT_MS
    int "DHCP wait timeout (ms)"
    default 8000

config LAN_TEST_PING_TARGET
    string "Optional ping target IPv4 address"
    default "8.8.8.8"
    help
        The demo treats link plus DHCP as the board hardware test. Failure to
        reach this address is reported as a warning because many networks
        block ICMP or do not provide Internet access.

endmenu
```

## SOFTWARE/ESP-IDF/p4_production_test/components/audio_loopback_test/Kconfig.projbuild
```kconfig
menu "Audio Loopback Test (ES8311)"
    config AUDIO_TEST_I2C_PORT
        int "I2C port"
        default 0
    config AUDIO_TEST_I2C_SDA_GPIO
        int "I2C SDA GPIO"
        default 7
    config AUDIO_TEST_I2C_SCL_GPIO
        int "I2C SCL GPIO"
        default 8
    config AUDIO_TEST_I2C_FREQ_HZ
        int "I2C frequency (Hz)"
        default 400000

    config AUDIO_TEST_I2S_PORT
        int "I2S port"
        default 0
    config AUDIO_TEST_I2S_MCLK_GPIO
        int "I2S MCLK GPIO"
        default 13
    config AUDIO_TEST_I2S_DOUT_GPIO
        int "I2S DOUT (ADOUT) GPIO"
        default 11
    config AUDIO_TEST_I2S_BCLK_GPIO
        int "I2S BCLK (SCLK) GPIO"
        default 12
    config AUDIO_TEST_I2S_DIN_GPIO
        int "I2S DIN (DSDIN) GPIO"
        default 9
    config AUDIO_TEST_I2S_WS_GPIO
        int "I2S WS (LRCK) GPIO"
        default 10

    config AUDIO_TEST_CODEC_PWR_GPIO
        int "Codec power control GPIO (set -1 to disable)"
        default 6
    config AUDIO_TEST_CODEC_PWR_ACTIVE_HIGH
        bool "Codec power GPIO active high"
        default y
    config AUDIO_TEST_CODEC_PWR_DEFAULT_INPUT
        bool "Keep codec power GPIO as INPUT (hi-z)"
        default y

    config AUDIO_TEST_SAMPLE_RATE
        int "Sample rate (Hz)"
        default 16000
    config AUDIO_TEST_BITS_PER_SAMPLE
        int "Bits per sample"
        default 16
    config AUDIO_TEST_CHANNELS
        int "Channels (1=mono, 2=stereo)"
        default 1
    config AUDIO_TEST_DMA_FRAME_SAMPLES
        int "DMA frame size (samples per channel)"
        default 512
    config AUDIO_TEST_TASK_STACK
        int "Loopback task stack bytes"
        default 4096
    config AUDIO_TEST_TASK_PRIO
        int "Loopback task priority"
        default 12
endmenu
```

## SOFTWARE/ESP-IDF/p4_production_test/components/lan_test/Kconfig
```kconfig
menu "LAN Test"

config LAN_TEST_PHY_ADDR
    int "PHY address"
    default 1

config LAN_TEST_PHY_RST_GPIO
    int "PHY reset GPIO (-1 = none)"
    default -1

config LAN_TEST_MDC_GPIO
    int "SMI MDC GPIO"
    default 41

config LAN_TEST_MDIO_GPIO
    int "SMI MDIO GPIO"
    default 40

config LAN_TEST_RMII_CLK_IN_GPIO
    int "RMII REF_CLK input GPIO (EMAC_RMII_CLK)"
    default 50

config LAN_TEST_DHCP_TIMEOUT_MS
    int "DHCP wait timeout (ms)"
    default 8000

endmenu
```

## SOFTWARE/ESP-IDF/p4_production_test/components/pt_display/Kconfig
```kconfig
menu "PT Display / HDMI test"

config PT_BTN_GPIO
    int "Button GPIO number"
    default 9
    help
        GPIO на бутона за теста.

config PT_BTN_ACTIVE_LOW
    bool "Button is active low"
    default y

config PT_BTN_PULLUP
    bool "Enable internal pull-up on button"
    default y

config PT_BTN_PULLDOWN
    bool "Enable internal pull-down on button"
    default n

config PT_BTN_LONGPRESS_MS
    int "Long press threshold (ms)"
    default 2000

config PT_DISPLAY_INIT_DELAY_MS
    int "Initial delay after HDMI init (ms)"
    default 300

endmenu
```

## SOFTWARE/ESP-IDF/p4_production_test/components/sd_card_test/Kconfig.projbuild
```kconfig
menu "SD Card Test (sd_card_test)"

config SD_TEST_INIT_DELAY_MS
    int "Delay after SD power-on (ms)"
    default 100
    range 0 2000

config SD_TEST_RETRY_COUNT
    int "Init retry count (power-cycle retries)"
    default 2
    range 0 10

config SD_TEST_MAX_FREQ_KHZ
    int "SDMMC max frequency (kHz)"
    default 20000
    range 400 40000
    help
        Conservative default is 20000 (20MHz). You can try 10000 or 400 (probing)
        for signal integrity debugging.

config SD_TEST_BUS_WIDTH
    int "SDMMC bus width"
    default 4
    range 1 4
    help
        Set to 4 for DAT0..DAT3 wiring. Use 1 for debugging.

config SD_TEST_PWR_GPIO
    int "SD Power control GPIO (-1 = none)"
    default -1

config SD_TEST_PWR_ON_LEVEL
    int "SD Power GPIO ON level (0/1)"
    default 0
    range 0 1

config SD_TEST_USE_ONCHIP_LDO
    bool "Enable on-chip LDO power control for SDMMC IO domain (if supported)"
    default y
    depends on SOC_SDMMC_IO_POWER_EXTERNAL
    help
        Some SoCs/boards require initializing on-chip LDO power control when using specific SDMMC IO pins/domains.

config SD_TEST_LDO_CHAN_ID
    int "On-chip LDO channel id"
    default 0
    depends on SD_TEST_USE_ONCHIP_LDO

config SD_TEST_PIN_CLK
    int "SDMMC CLK GPIO (-1 = default slot mapping)"
    default -1
config SD_TEST_PIN_CMD
    int "SDMMC CMD GPIO (-1 = default slot mapping)"
    default -1
config SD_TEST_PIN_D0
    int "SDMMC D0 GPIO (-1 = default slot mapping)"
    default -1
config SD_TEST_PIN_D1
    int "SDMMC D1 GPIO (-1 = default slot mapping)"
    default -1
config SD_TEST_PIN_D2
    int "SDMMC D2 GPIO (-1 = default slot mapping)"
    default -1
config SD_TEST_PIN_D3
    int "SDMMC D3 GPIO (-1 = default slot mapping)"
    default -1

config SD_TEST_PIN_CD
    int "Card Detect GPIO (-1 = none)"
    default -1
config SD_TEST_PIN_WP
    int "Write Protect GPIO (-1 = none)"
    default -1

endmenu
```
